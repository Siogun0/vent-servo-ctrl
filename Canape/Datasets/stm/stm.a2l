/* @@@@ File written by CANAPE_VERSION 14 0 52 @@@@ */ ASAP2_VERSION 1 51
/begin PROJECT stm_iface ""
/begin MODULE iface ""
/begin MOD_COMMON "" BYTE_ORDER MSB_LAST ALIGNMENT_BYTE 1 ALIGNMENT_WORD 1 ALIGNMENT_LONG 1 ALIGNMENT_FLOAT32_IEEE 1 ALIGNMENT_FLOAT64_IEEE 1 /end MOD_COMMON
/begin IF_DATA XCP
 /begin PROTOCOL_LAYER 0x0100 0x07D0 0x07D0 0x00 0x00 0x00 0x00 0x00 0x08 0x08 BYTE_ORDER_MSB_LAST ADDRESS_GRANULARITY_BYTE OPTIONAL_CMD PROGRAM_RESET OPTIONAL_CMD PROGRAM OPTIONAL_CMD PROGRAM_CLEAR OPTIONAL_CMD PROGRAM_START OPTIONAL_CMD GET_DAQ_EVENT_INFO OPTIONAL_CMD GET_DAQ_CLOCK OPTIONAL_CMD START_STOP_SYNCH OPTIONAL_CMD START_STOP_DAQ_LIST OPTIONAL_CMD GET_DAQ_LIST_MODE OPTIONAL_CMD SET_DAQ_LIST_MODE OPTIONAL_CMD WRITE_DAQ OPTIONAL_CMD SET_DAQ_PTR OPTIONAL_CMD CLEAR_DAQ_LIST OPTIONAL_CMD COPY_CAL_PAGE OPTIONAL_CMD GET_PAG_PROCESSOR_INFO OPTIONAL_CMD MODIFY_BITS OPTIONAL_CMD DOWNLOAD_NEXT OPTIONAL_CMD TRANSPORT_LAYER_CMD OPTIONAL_CMD UPLOAD OPTIONAL_CMD SET_MTA OPTIONAL_CMD SET_REQUEST OPTIONAL_CMD GET_ID OPTIONAL_CMD GET_COMM_MODE_INFO /end PROTOCOL_LAYER
 /begin DAQ DYNAMIC 0x00 0x00 0x00 OPTIMISATION_TYPE_DEFAULT ADDRESS_EXTENSION_DAQ IDENTIFICATION_FIELD_TYPE_ABSOLUTE GRANULARITY_ODT_ENTRY_SIZE_DAQ_BYTE 0x04 NO_OVERLOAD_INDICATION PRESCALER_SUPPORTED /begin TIMESTAMP_SUPPORTED 0x1800 SIZE_DWORD UNIT_10NS /end TIMESTAMP_SUPPORTED PID_OFF_SUPPORTED /end DAQ
 /begin PAG 0x01 /end PAG
 /begin PGM PGM_MODE_ABSOLUTE 0x40 0x00 /begin SECTOR "FLASH" 0x00 0x08000000 0x0400 0x00 0x00 0x00 /end SECTOR /begin SECTOR "FLASH" 0x01 0x08000400 0x0400 0x00 0x00 0x00 /end SECTOR /begin SECTOR "FLASH" 0x02 0x08000800 0x0400 0x00 0x00 0x00 /end SECTOR /begin SECTOR "FLASH" 0x03 0x08000C00 0x0400 0x00 0x00 0x00 /end SECTOR /begin SECTOR "FLASH" 0x04 0x08001000 0x0400 0x00 0x00 0x00 /end SECTOR /begin SECTOR "FLASH" 0x05 0x08001400 0x0400 0x00 0x00 0x00 /end SECTOR /begin SECTOR "FLASH" 0x06 0x08001800 0x0400 0x00 0x00 0x00 /end SECTOR /begin SECTOR "FLASH" 0x07 0x08001C00 0x0400 0x00 0x00 0x00 /end SECTOR /begin SECTOR "FLASH" 0x08 0x08002000 0x0400 0x00 0x00 0x00 /end SECTOR /begin SECTOR "FLASH" 0x09 0x08002400 0x0400 0x00 0x00 0x00 /end SECTOR /begin SECTOR "FLASH" 0x0A 0x08002800 0x0400 0x00 0x00 0x00 /end SECTOR /begin SECTOR "FLASH" 0x0B 0x08002C00 0x0400 0x00 0x00 0x00 /end SECTOR /begin SECTOR "FLASH" 0x0C 0x08003000 0x0400 0x00 0x00 0x00 /end SECTOR /begin SECTOR "FLASH" 0x0D 0x08003400 0x0400 0x00 0x00 0x00 /end SECTOR /begin SECTOR "FLASH" 0x0E 0x08003800 0x0400 0x00 0x00 0x00 /end SECTOR /begin SECTOR "FLASH" 0x0F 0x08003C00 0x0400 0x00 0x00 0x00 /end SECTOR /begin SECTOR "FLASH" 0x10 0x08004000 0x0400 0x00 0x00 0x00 /end SECTOR /begin SECTOR "FLASH" 0x11 0x08004400 0x0400 0x00 0x00 0x00 /end SECTOR /begin SECTOR "FLASH" 0x12 0x08004800 0x0400 0x00 0x00 0x00 /end SECTOR /begin SECTOR "FLASH" 0x13 0x08004C00 0x0400 0x00 0x00 0x00 /end SECTOR /begin SECTOR "FLASH" 0x14 0x08005000 0x0400 0x00 0x00 0x00 /end SECTOR /begin SECTOR "FLASH" 0x15 0x08005400 0x0400 0x00 0x00 0x00 /end SECTOR /begin SECTOR "FLASH" 0x16 0x08005800 0x0400 0x00 0x00 0x00 /end SECTOR /begin SECTOR "FLASH" 0x17 0x08005C00 0x0400 0x00 0x00 0x00 /end SECTOR /begin SECTOR "FLASH" 0x18 0x08006000 0x0400 0x00 0x00 0x00 /end SECTOR /begin SECTOR "FLASH" 0x19 0x08006400 0x0400 0x00 0x00 0x00 /end SECTOR /begin SECTOR "FLASH" 0x1A 0x08006800 0x0400 0x00 0x00 0x00 /end SECTOR /begin SECTOR "FLASH" 0x1B 0x08006C00 0x0400 0x00 0x00 0x00 /end SECTOR /begin SECTOR "FLASH" 0x1C 0x08007000 0x0400 0x00 0x00 0x00 /end SECTOR /begin SECTOR "FLASH" 0x1D 0x08007400 0x0400 0x00 0x00 0x00 /end SECTOR /begin SECTOR "FLASH" 0x1E 0x08007800 0x0400 0x00 0x00 0x00 /end SECTOR /begin SECTOR "FLASH" 0x1F 0x08007C00 0x0400 0x00 0x00 0x00 /end SECTOR /begin SECTOR "FLASH" 0x20 0x08008000 0x0400 0x00 0x00 0x00 /end SECTOR /begin SECTOR "FLASH" 0x21 0x08008400 0x0400 0x00 0x00 0x00 /end SECTOR /begin SECTOR "FLASH" 0x22 0x08008800 0x0400 0x00 0x00 0x00 /end SECTOR /begin SECTOR "FLASH" 0x23 0x08008C00 0x0400 0x00 0x00 0x00 /end SECTOR /begin SECTOR "FLASH" 0x24 0x08009000 0x0400 0x00 0x00 0x00 /end SECTOR /begin SECTOR "FLASH" 0x25 0x08009400 0x0400 0x00 0x00 0x00 /end SECTOR /begin SECTOR "FLASH" 0x26 0x08009800 0x0400 0x00 0x00 0x00 /end SECTOR /begin SECTOR "FLASH" 0x27 0x08009C00 0x0400 0x00 0x00 0x00 /end SECTOR /begin SECTOR "FLASH" 0x28 0x0800A000 0x0400 0x00 0x00 0x00 /end SECTOR /begin SECTOR "FLASH" 0x29 0x0800A400 0x0400 0x00 0x00 0x00 /end SECTOR /begin SECTOR "FLASH" 0x2A 0x0800A800 0x0400 0x00 0x00 0x00 /end SECTOR /begin SECTOR "FLASH" 0x2B 0x0800AC00 0x0400 0x00 0x00 0x00 /end SECTOR /begin SECTOR "FLASH" 0x2C 0x0800B000 0x0400 0x00 0x00 0x00 /end SECTOR /begin SECTOR "FLASH" 0x2D 0x0800B400 0x0400 0x00 0x00 0x00 /end SECTOR /begin SECTOR "FLASH" 0x2E 0x0800B800 0x0400 0x00 0x00 0x00 /end SECTOR /begin SECTOR "FLASH" 0x2F 0x0800BC00 0x0400 0x00 0x00 0x00 /end SECTOR /begin SECTOR "FLASH" 0x30 0x0800C000 0x0400 0x00 0x00 0x00 /end SECTOR /begin SECTOR "FLASH" 0x31 0x0800C400 0x0400 0x00 0x00 0x00 /end SECTOR /begin SECTOR "FLASH" 0x32 0x0800C800 0x0400 0x00 0x00 0x00 /end SECTOR /begin SECTOR "FLASH" 0x33 0x0800CC00 0x0400 0x00 0x00 0x00 /end SECTOR /begin SECTOR "FLASH" 0x34 0x0800D000 0x0400 0x00 0x00 0x00 /end SECTOR /begin SECTOR "FLASH" 0x35 0x0800D400 0x0400 0x00 0x00 0x00 /end SECTOR /begin SECTOR "FLASH" 0x36 0x0800D800 0x0400 0x00 0x00 0x00 /end SECTOR /begin SECTOR "FLASH" 0x37 0x0800DC00 0x0400 0x00 0x00 0x00 /end SECTOR /begin SECTOR "FLASH" 0x38 0x0800E000 0x0400 0x00 0x00 0x00 /end SECTOR /begin SECTOR "FLASH" 0x39 0x0800E400 0x0400 0x00 0x00 0x00 /end SECTOR /begin SECTOR "FLASH" 0x3A 0x0800E800 0x0400 0x00 0x00 0x00 /end SECTOR /begin SECTOR "FLASH" 0x3B 0x0800EC00 0x0400 0x00 0x00 0x00 /end SECTOR /begin SECTOR "FLASH" 0x3C 0x0800F000 0x0400 0x00 0x00 0x00 /end SECTOR /begin SECTOR "FLASH" 0x3D 0x0800F400 0x0400 0x00 0x00 0x00 /end SECTOR /begin SECTOR "FLASH" 0x3E 0x0800F800 0x0400 0x00 0x00 0x00 /end SECTOR /begin SECTOR "FLASH" 0x3F 0x0800FC00 0x0400 0x00 0x00 0x00 /end SECTOR /end PGM
 /begin XCP_ON_UDP_IP 0x0100 0x4653 ADDRESS "7.7.7.205" /end XCP_ON_UDP_IP
 /begin XCP_ON_CAN 0x0100 CAN_ID_MASTER 0x15 CAN_ID_SLAVE 0x16 BAUDRATE 0x07A120 SAMPLE_POINT 0x4B SAMPLE_RATE SINGLE BTL_CYCLES 0x08 SJW 0x02 SYNC_EDGE SINGLE /end XCP_ON_CAN
/end IF_DATA
/begin MOD_PAR ""
 /begin MEMORY_SEGMENT CAL "" DATA FLASH INTERN 0x8003C00 0x400 -1 -1 -1 -1 -1
  /begin IF_DATA XCP
   /begin SEGMENT 0x00 0x01 0x00 0x00 0x00
    /begin PAGE 0x00 ECU_ACCESS_ALLOWED_DONT_CARE XCP_READ_ACCESS_ALLOWED_DONT_CARE XCP_WRITE_ACCESS_NOT_ALLOWED /end PAGE
    /begin ADDRESS_MAPPING 0x08003C00 0x20004C00 0x0400 /end ADDRESS_MAPPING
   /end SEGMENT
  /end IF_DATA
 /end MEMORY_SEGMENT
 /begin MEMORY_SEGMENT CAL "" DATA RAM INTERN 0x20004C00 0x400 -1 -1 -1 -1 -1
  /begin IF_DATA XCP
   /begin SEGMENT 0x01 0x01 0x00 0x00 0x00
    /begin PAGE 0x00 ECU_ACCESS_ALLOWED_DONT_CARE XCP_READ_ACCESS_ALLOWED_DONT_CARE XCP_WRITE_ACCESS_ALLOWED_DONT_CARE INIT_SEGMENT 0x00 /end PAGE
   /end SEGMENT
  /end IF_DATA
 /end MEMORY_SEGMENT
/end MOD_PAR
/begin COMPU_METHOD param.servo_close_us_1.CONVERSION "@@@@RuleName created by CANape" RAT_FUNC "%3.1" "us" COEFFS 0 1 0 0 0 1 /end COMPU_METHOD
/begin COMPU_METHOD param.servo_close_us_2.CONVERSION "@@@@RuleName created by CANape" RAT_FUNC "%3.1" "us" COEFFS 0 1 0 0 0 1 /end COMPU_METHOD
/begin COMPU_METHOD param.servo_close_us_3.CONVERSION "@@@@RuleName created by CANape" RAT_FUNC "%3.1" "us" COEFFS 0 1 0 0 0 1 /end COMPU_METHOD
/begin COMPU_METHOD param.servo_close_us_4.CONVERSION "@@@@RuleName created by CANape" RAT_FUNC "%3.1" "us" COEFFS 0 1 0 0 0 1 /end COMPU_METHOD
/begin COMPU_METHOD param.servo_open_us_1.CONVERSION "@@@@RuleName created by CANape" RAT_FUNC "%3.1" "us" COEFFS 0 1 0 0 0 1 /end COMPU_METHOD
/begin COMPU_METHOD param.servo_open_us_2.CONVERSION "@@@@RuleName created by CANape" RAT_FUNC "%3.1" "us" COEFFS 0 1 0 0 0 1 /end COMPU_METHOD
/begin COMPU_METHOD param.servo_open_us_3.CONVERSION "@@@@RuleName created by CANape" RAT_FUNC "%3.1" "us" COEFFS 0 1 0 0 0 1 /end COMPU_METHOD
/begin COMPU_METHOD param.servo_open_us_4.CONVERSION "@@@@RuleName created by CANape" RAT_FUNC "%3.1" "us" COEFFS 0 1 0 0 0 1 /end COMPU_METHOD
/begin COMPU_METHOD param.servo_power_time.CONVERSION "@@@@RuleName created by CANape" RAT_FUNC "%3.1" "ms" COEFFS 0 1 0 0 0 1 /end COMPU_METHOD
/begin COMPU_VTAB v.servo_power.CONVERSION "@@@@RuleName created by CANape" TAB_VERB 2 0 "Disable" 1 "Enable" DEFAULT_VALUE "" /end COMPU_VTAB
/begin COMPU_METHOD v.servo_power.CONVERSION "@@@@RuleName created by CANape" TAB_VERB "%3.1" "" COMPU_TAB_REF v.servo_power.CONVERSION /end COMPU_METHOD
/begin COMPU_VTAB v.update_boot.CONVERSION "@@@@RuleName created by CANape" TAB_VERB 3 0 "None" 1 "Request" 2 "Boot Upd. Activated" DEFAULT_VALUE "" /end COMPU_VTAB
/begin COMPU_METHOD v.update_boot.CONVERSION "@@@@RuleName created by CANape" TAB_VERB "%3.1" "" COMPU_TAB_REF v.update_boot.CONVERSION /end COMPU_METHOD
/begin COMPU_VTAB v.valve_status_1.CONVERSION "@@@@RuleName created by CANape" TAB_VERB 7 0 "Undefined" 1 "Opened" 2 "Closed" 3 "Partialy" 4 "Moving" 5 "ShortCircuit" 6 "OpenCircuit" DEFAULT_VALUE "0" /end COMPU_VTAB
/begin COMPU_METHOD v.valve_status_1.CONVERSION "@@@@RuleName created by CANape" TAB_VERB "%3.1" "" COMPU_TAB_REF v.valve_status_1.CONVERSION /end COMPU_METHOD
/begin COMPU_VTAB v.valve_status_2.CONVERSION "@@@@RuleName created by CANape" TAB_VERB 7 0 "Undefined" 1 "Opened" 2 "Closed" 3 "Partialy" 4 "Moving" 5 "ShortCircuit" 6 "OpenCircuit" DEFAULT_VALUE "0" /end COMPU_VTAB
/begin COMPU_METHOD v.valve_status_2.CONVERSION "@@@@RuleName created by CANape" TAB_VERB "%3.1" "" COMPU_TAB_REF v.valve_status_2.CONVERSION /end COMPU_METHOD
/begin COMPU_VTAB v.valve_status_3.CONVERSION "@@@@RuleName created by CANape" TAB_VERB 7 0 "Undefined" 1 "Opened" 2 "Closed" 3 "Partialy" 4 "Moving" 5 "ShortCircuit" 6 "OpenCircuit" DEFAULT_VALUE "0" /end COMPU_VTAB
/begin COMPU_METHOD v.valve_status_3.CONVERSION "@@@@RuleName created by CANape" TAB_VERB "%3.1" "" COMPU_TAB_REF v.valve_status_3.CONVERSION /end COMPU_METHOD
/begin COMPU_VTAB v.valve_status_4.CONVERSION "@@@@RuleName created by CANape" TAB_VERB 7 0 "Undefined" 1 "Opened" 2 "Closed" 3 "Partialy" 4 "Moving" 5 "ShortCircuit" 6 "OpenCircuit" DEFAULT_VALUE "0" /end COMPU_VTAB
/begin COMPU_METHOD v.valve_status_4.CONVERSION "@@@@RuleName created by CANape" TAB_VERB "%3.1" "" COMPU_TAB_REF v.valve_status_4.CONVERSION /end COMPU_METHOD
/begin CHARACTERISTIC app_build_date "" ASCII 0x800FFC0 __UBYTE_Z 0 NO_COMPU_METHOD 0 255 NUMBER 32 /end CHARACTERISTIC
/begin CHARACTERISTIC app_version "" ASCII 0x800FFA0 __UBYTE_Z 0 NO_COMPU_METHOD 0 255 NUMBER 32 /end CHARACTERISTIC
/begin CHARACTERISTIC bootloader_build_date "" ASCII 0x8003BC0 __UBYTE_Z 0 NO_COMPU_METHOD 0 255 NUMBER 32 /end CHARACTERISTIC
/begin CHARACTERISTIC bootloader_version "" ASCII 0x8003BA0 __UBYTE_Z 0 NO_COMPU_METHOD 0 255 NUMBER 32 /end CHARACTERISTIC
/begin CHARACTERISTIC param.common.crc "" VALUE 0x20004C00 __ULONG_S 0 NO_COMPU_METHOD 0 4294967295 FORMAT "%.15" MAX_REFRESH 6 1 /end CHARACTERISTIC
/begin CHARACTERISTIC param.common.size "" VALUE 0x20004C04 __ULONG_S 0 NO_COMPU_METHOD 0 4294967295 FORMAT "%.15" /end CHARACTERISTIC
/begin CHARACTERISTIC param.crc "" VALUE 0x20004C40 __ULONG_S 0 NO_COMPU_METHOD 0 4294967295 FORMAT "%.15" MAX_REFRESH 6 1 /end CHARACTERISTIC
/begin CHARACTERISTIC param.servo_close_us_1 "" VALUE 0x20004C48 __UWORD_S 0 param.servo_close_us_1.CONVERSION 0 65535 FORMAT "%.15" /end CHARACTERISTIC
/begin CHARACTERISTIC param.servo_close_us_2 "" VALUE 0x20004C4A __UWORD_S 0 param.servo_close_us_2.CONVERSION 0 65535 FORMAT "%.15" /end CHARACTERISTIC
/begin CHARACTERISTIC param.servo_close_us_3 "" VALUE 0x20004C4C __UWORD_S 0 param.servo_close_us_3.CONVERSION 0 65535 FORMAT "%.15" /end CHARACTERISTIC
/begin CHARACTERISTIC param.servo_close_us_4 "" VALUE 0x20004C4E __UWORD_S 0 param.servo_close_us_4.CONVERSION 0 65535 FORMAT "%.15" /end CHARACTERISTIC
/begin CHARACTERISTIC param.servo_open_us_1 "" VALUE 0x20004C58 __UWORD_S 0 param.servo_open_us_1.CONVERSION 0 65535 FORMAT "%.15" /end CHARACTERISTIC
/begin CHARACTERISTIC param.servo_open_us_2 "" VALUE 0x20004C5A __UWORD_S 0 param.servo_open_us_2.CONVERSION 0 65535 FORMAT "%.15" /end CHARACTERISTIC
/begin CHARACTERISTIC param.servo_open_us_3 "" VALUE 0x20004C5C __UWORD_S 0 param.servo_open_us_3.CONVERSION 0 65535 FORMAT "%.15" /end CHARACTERISTIC
/begin CHARACTERISTIC param.servo_open_us_4 "" VALUE 0x20004C5E __UWORD_S 0 param.servo_open_us_4.CONVERSION 0 65535 FORMAT "%.15" /end CHARACTERISTIC
/begin CHARACTERISTIC param.servo_power_time "" VALUE 0x20004C68 __ULONG_S 0 param.servo_power_time.CONVERSION 0 4294967295 FORMAT "%.15" /end CHARACTERISTIC
/begin CHARACTERISTIC param.size "" VALUE 0x20004C44 __ULONG_S 0 NO_COMPU_METHOD 0 4294967295 FORMAT "%.15" /end CHARACTERISTIC
/begin CHARACTERISTIC param.xcp_canid_rx "" VALUE 0x20004C08 __ULONG_S 0 NO_COMPU_METHOD 0 4294967295 FORMAT "%.15" /end CHARACTERISTIC
/begin CHARACTERISTIC param.xcp_canid_tx "" VALUE 0x20004C0C __ULONG_S 0 NO_COMPU_METHOD 0 4294967295 FORMAT "%.15" /end CHARACTERISTIC
/begin MEASUREMENT v.ADC[0] "" UWORD NO_COMPU_METHOD 0 0 0 65535 ECU_ADDRESS 0x20003C10 FORMAT "%.15" /end MEASUREMENT
/begin MEASUREMENT v.ADC[1] "" UWORD NO_COMPU_METHOD 0 0 0 65535 ECU_ADDRESS 0x20003C12 FORMAT "%.15" /end MEASUREMENT
/begin MEASUREMENT v.ADC[2] "" UWORD NO_COMPU_METHOD 0 0 0 65535 ECU_ADDRESS 0x20003C14 FORMAT "%.15" /end MEASUREMENT
/begin MEASUREMENT v.ADC[3] "" UWORD NO_COMPU_METHOD 0 0 0 65535 ECU_ADDRESS 0x20003C16 FORMAT "%.15" /end MEASUREMENT
/begin MEASUREMENT v.CPU_TEMP "" FLOAT32_IEEE NO_COMPU_METHOD 0 0 -3.40282346639e+038 3.40282346639e+038 ECU_ADDRESS 0x20003C20 FORMAT "%.15" /end MEASUREMENT
/begin MEASUREMENT v.VCC "" FLOAT32_IEEE NO_COMPU_METHOD 0 0 -3.40282346639e+038 3.40282346639e+038 ECU_ADDRESS 0x20003C24 FORMAT "%.15" /end MEASUREMENT
/begin MEASUREMENT v.current_servo "" FLOAT32_IEEE NO_COMPU_METHOD 0 0 -3.40282346639e+038 3.40282346639e+038 ECU_ADDRESS 0x20003C4C FORMAT "%.15" /end MEASUREMENT
/begin MEASUREMENT v.power_servo "" FLOAT32_IEEE NO_COMPU_METHOD 0 0 -3.40282346639e+038 3.40282346639e+038 ECU_ADDRESS 0x20003C50 FORMAT "%.15" /end MEASUREMENT
/begin MEASUREMENT v.servo_power "" ULONG v.servo_power.CONVERSION 0 0 0 4294967295 ECU_ADDRESS 0x20003C44 FORMAT "%.15" /end MEASUREMENT
/begin CHARACTERISTIC v.update_boot "" VALUE 0x20003C00 __UBYTE_S 0 v.update_boot.CONVERSION 0 255 FORMAT "%.15" /end CHARACTERISTIC
/begin MEASUREMENT v.valve_status_1 "" UBYTE v.valve_status_1.CONVERSION 0 0 0 255 ECU_ADDRESS 0x20003C38 FORMAT "%.15" /end MEASUREMENT
/begin MEASUREMENT v.valve_status_2 "" UBYTE v.valve_status_2.CONVERSION 0 0 0 255 ECU_ADDRESS 0x20003C39 FORMAT "%.15" /end MEASUREMENT
/begin MEASUREMENT v.valve_status_3 "" UBYTE v.valve_status_3.CONVERSION 0 0 0 255 ECU_ADDRESS 0x20003C3A FORMAT "%.15" /end MEASUREMENT
/begin MEASUREMENT v.valve_status_4 "" UBYTE v.valve_status_4.CONVERSION 0 0 0 255 ECU_ADDRESS 0x20003C3B FORMAT "%.15" /end MEASUREMENT
/begin MEASUREMENT v.voltage_servo "" FLOAT32_IEEE NO_COMPU_METHOD 0 0 -3.40282346639e+038 3.40282346639e+038 ECU_ADDRESS 0x20003C48 FORMAT "%.15" /end MEASUREMENT
/begin GROUP measure "" ROOT
 /begin REF_MEASUREMENT v.ADC[0] v.ADC[1] v.ADC[2] v.ADC[3] v.CPU_TEMP v.VCC v.current_servo v.power_servo v.servo_power v.valve_status_1 v.valve_status_2 v.valve_status_3 v.valve_status_4 v.voltage_servo /end REF_MEASUREMENT
/end GROUP
/begin GROUP param "" ROOT
 /begin REF_CHARACTERISTIC param.servo_close_us_1 param.servo_close_us_2 param.servo_close_us_3 param.servo_close_us_4 param.servo_open_us_1 param.servo_open_us_2 param.servo_open_us_3 param.servo_open_us_4 param.servo_power_time param.xcp_canid_rx param.xcp_canid_tx /end REF_CHARACTERISTIC
/end GROUP
/begin RECORD_LAYOUT __UBYTE_Z FNC_VALUES 1 UBYTE ROW_DIR DIRECT /end RECORD_LAYOUT
/begin RECORD_LAYOUT __UWORD_Z FNC_VALUES 1 UWORD ROW_DIR DIRECT /end RECORD_LAYOUT
/begin RECORD_LAYOUT __ULONG_Z FNC_VALUES 1 ULONG ROW_DIR DIRECT /end RECORD_LAYOUT
/begin RECORD_LAYOUT __SBYTE_Z FNC_VALUES 1 SBYTE ROW_DIR DIRECT /end RECORD_LAYOUT
/begin RECORD_LAYOUT __SWORD_Z FNC_VALUES 1 SWORD ROW_DIR DIRECT /end RECORD_LAYOUT
/begin RECORD_LAYOUT __SLONG_Z FNC_VALUES 1 SLONG ROW_DIR DIRECT /end RECORD_LAYOUT
/begin RECORD_LAYOUT __FLOAT32_IEEE_Z FNC_VALUES 1 FLOAT32_IEEE ROW_DIR DIRECT /end RECORD_LAYOUT
/begin RECORD_LAYOUT __FLOAT64_IEEE_Z FNC_VALUES 1 FLOAT64_IEEE ROW_DIR DIRECT /end RECORD_LAYOUT
/begin RECORD_LAYOUT __UBYTE_S FNC_VALUES 1 UBYTE COLUMN_DIR DIRECT /end RECORD_LAYOUT
/begin RECORD_LAYOUT __UWORD_S FNC_VALUES 1 UWORD COLUMN_DIR DIRECT /end RECORD_LAYOUT
/begin RECORD_LAYOUT __ULONG_S FNC_VALUES 1 ULONG COLUMN_DIR DIRECT /end RECORD_LAYOUT
/begin RECORD_LAYOUT __SBYTE_S FNC_VALUES 1 SBYTE COLUMN_DIR DIRECT /end RECORD_LAYOUT
/begin RECORD_LAYOUT __SWORD_S FNC_VALUES 1 SWORD COLUMN_DIR DIRECT /end RECORD_LAYOUT
/begin RECORD_LAYOUT __SLONG_S FNC_VALUES 1 SLONG COLUMN_DIR DIRECT /end RECORD_LAYOUT
/begin RECORD_LAYOUT __FLOAT32_IEEE_S FNC_VALUES 1 FLOAT32_IEEE COLUMN_DIR DIRECT /end RECORD_LAYOUT
/begin RECORD_LAYOUT __FLOAT64_IEEE_S FNC_VALUES 1 FLOAT64_IEEE COLUMN_DIR DIRECT /end RECORD_LAYOUT
/begin RECORD_LAYOUT SSV__UBYTE_S AXIS_PTS_X 1 UBYTE INDEX_INCR DIRECT /end RECORD_LAYOUT
/begin RECORD_LAYOUT SSV__UWORD_S AXIS_PTS_X 1 UWORD INDEX_INCR DIRECT /end RECORD_LAYOUT
/begin RECORD_LAYOUT SSV__ULONG_S AXIS_PTS_X 1 ULONG INDEX_INCR DIRECT /end RECORD_LAYOUT
/begin RECORD_LAYOUT SSV__SBYTE_S AXIS_PTS_X 1 SBYTE INDEX_INCR DIRECT /end RECORD_LAYOUT
/begin RECORD_LAYOUT SSV__SWORD_S AXIS_PTS_X 1 SWORD INDEX_INCR DIRECT /end RECORD_LAYOUT
/begin RECORD_LAYOUT SSV__SLONG_S AXIS_PTS_X 1 SLONG INDEX_INCR DIRECT /end RECORD_LAYOUT
/begin RECORD_LAYOUT SSV__FLOAT32_IEEE_S AXIS_PTS_X 1 FLOAT32_IEEE INDEX_INCR DIRECT /end RECORD_LAYOUT
/begin RECORD_LAYOUT SSV__FLOAT64_IEEE_S AXIS_PTS_X 1 FLOAT64_IEEE INDEX_INCR DIRECT /end RECORD_LAYOUT
/end MODULE
/end PROJECT
